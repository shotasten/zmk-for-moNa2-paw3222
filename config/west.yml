## config/west.yml
```yaml
manifest:
  remotes:
    - name: zmkfirmware
      url-base: https://github.com/zmkfirmware
    - name: prospector
      url-base: https://github.com/t-ogura
    - name: sayu-hub
      url-base: https://github.com/sayu-hub
    # - name: badjeff    # <-- PMW3610
    #   url-base: https://github.com/badjeff
    - name: shotasten  # <-- PAW3222 (8ms polling fork)
      url-base: https://github.com/shotasten
    - name: caksoylar  # <-- RGB LED
      url-base: https://github.com/caksoylar  
    - name: zettaface  # <-- Input Processor Keybind
      url-base: https://github.com/zettaface
    - name: gohanda11  # <-- Threshold Temp Layer
      url-base: https://github.com/gohanda11
  projects:
    - name: zmk
      remote: zmkfirmware
      revision: v0.3
      import: app/west.yml
    - name: prospector-zmk-module
      remote: prospector
      revision: v2.0.0
      path: modules/prospector-zmk-module
    # - name: zmk-pmw3610-driver
    #   remote: badjeff
    #   revision: main
    - name: zmk-driver-paw3222
      remote: shotasten
      revision: d509519bf437a498d1f05f4b87af5801e0d9f5c5
    - name: zmk-rgbled-widget
      remote: caksoylar
      revision: v0.3
    - name: zmk-input-processor-keybind
      remote: zettaface
      revision: main
    - name: zmk-input-processor-threshold-temp-layer
      remote: gohanda11
      revision: main
  self:
    path: config
```
